/*
 * Copyright (c) 2020 Ryan Cross
 *
 * SPDX-License-Identifier: MIT
 */

#include "sofle.dtsi"

&kscan0 {
    	col-gpios
        	= <&pro_micro 9 (GPIO_ACTIVE_HIGH | GPIO_PULL_DOWN)>
        	, <&pro_micro 8 (GPIO_ACTIVE_HIGH | GPIO_PULL_DOWN)>
        	, <&pro_micro 7 (GPIO_ACTIVE_HIGH | GPIO_PULL_DOWN)>
        	, <&pro_micro 6 (GPIO_ACTIVE_HIGH | GPIO_PULL_DOWN)>
        	, <&pro_micro 5 (GPIO_ACTIVE_HIGH | GPIO_PULL_DOWN)>
        	, <&pro_micro 4 (GPIO_ACTIVE_HIGH | GPIO_PULL_DOWN)>
        	;
};



// &adc {
// 	status = "okay";
// };

/* 
 * / {
 * 	// MOUSE MOVE
 * 	anin1: analog_input_1 {
 * 		compatible = "zmk,analog-input";
 * 		sampling-hz = <100>;
 * 		x-ch {
 * 			io-channels = <&adc 0>;
 * 			mv-mid = <1650>;
 * 			mv-min-max = <10>;
 * 			mv-deadzone = <400>;
 * 			scale-multiplier = <2>;
 * 			scale-divisor = <3>;
 * 			invert;
 * 			evt-type = <INPUT_EV_REL>;
 * 			input-code = <INPUT_REL_X>;
 * 		};
 * 		y-ch {
 * 			io-channels = <&adc 5>;
 * 			mv-mid = <1650>;
 * 			mv-min-max = <10>;
 * 			mv-deadzone = <400>;
 * 			scale-multiplier = <2>;
 * 			scale-divisor = <3>;
 * 			invert;
 * 			evt-type = <INPUT_EV_REL>;
			input-code = <INPUT_REL_Y>;
 * 		};
 * 	};
 *      // MOUSE MOVE
 *         joystick_listener_1 {
 *             status = "okay";
 *             compatible = "zmk,input-listener";
 *             device = <&anin1>;
 *         };
 * };
 */
