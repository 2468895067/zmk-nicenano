/*
 * Copyright (c) 2020 The ZMK Contributors
 *
 * SPDX-License-Identifier: MIT
 */
// #define ZMK_POINTING_DEFAULT_MOVE_VAL 400  
// default: 600
// #define ZMK_POINTING_DEFAULT_SCRL_VAL 20    
// default: 10

#include <behaviors.dtsi>
#include <dt-bindings/zmk/bt.h>
#include <dt-bindings/zmk/keys.h>
#include <dt-bindings/zmk/pointing.h>

